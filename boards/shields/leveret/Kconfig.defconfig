## boards/shields/leveret/Kconfig.defconfig
```kconfig
if SHIELD_LEVERET_DONGLE

config ZMK_KEYBOARD_NAME
    default "leveret"

config ZMK_SPLIT_ROLE_CENTRAL
    default y

endif

if SHIELD_LEVERET_LEFT || SHIELD_LEVERET_RIGHT || SHIELD_LEVERET_LEFT

config ZMK_SPLIT
    default y

endif
```

## boards/shields/leveret/Kconfig.shield
```kconfig
config SHIELD_LEVERET_LEFT
    def_bool $(shields_list_contains,leveret_left)

config SHIELD_LEVERET_RIGHT
    def_bool $(shields_list_contains,leveret_right)

config SHIELD_LEVERET_DONGLE
    def_bool $(shields_list_contains,leveret_dongle)
```
