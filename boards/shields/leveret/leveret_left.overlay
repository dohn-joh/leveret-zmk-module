#include "leveret.dtsi"

&kscan0 {
	col-gpios
	= <&pro_micro 16 (GPIO_ACTIVE_HIGH)> // col 1
	, <&pro_micro 14 (GPIO_ACTIVE_HIGH)> // col 2
	, <&pro_micro 15 (GPIO_ACTIVE_HIGH)> // col 3
	, <&pro_micro 18 (GPIO_ACTIVE_HIGH)> // col 4
	, <&pro_micro 19 (GPIO_ACTIVE_HIGH)> // col 5
	, <&pro_micro 20 (GPIO_ACTIVE_HIGH)> // col 6
	, <&pro_micro 21 (GPIO_ACTIVE_HIGH)> // col 7
	;
    row-gpios
	= <&pro_micro 9 (GPIO_ACTIVE_HIGH | GPIO_PULL_DOWN)> // row 1
	, <&pro_micro 8 (GPIO_ACTIVE_HIGH | GPIO_PULL_DOWN)> // row 2
	, <&pro_micro 7 (GPIO_ACTIVE_HIGH | GPIO_PULL_DOWN)> // row 3
	, <&pro_micro 6 (GPIO_ACTIVE_HIGH | GPIO_PULL_DOWN)> // row 4
    ;
};
